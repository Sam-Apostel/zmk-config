#include "keycard.dtsi"


&default_transform {
    row-offset = <1>;
};

&kscan0 {
    input-gpios
    = <&pro_micro 7 (GPIO_ACTIVE_LOW | GPIO_PULL_UP)>
    , <&pro_micro 16 (GPIO_ACTIVE_LOW | GPIO_PULL_UP)>
    , <&pro_micro 3 (GPIO_ACTIVE_LOW | GPIO_PULL_UP)>
    , <&pro_micro 2 (GPIO_ACTIVE_LOW | GPIO_PULL_UP)>
    , <&pro_micro 14 (GPIO_ACTIVE_LOW | GPIO_PULL_UP)>
    , <&pro_micro 10 (GPIO_ACTIVE_LOW | GPIO_PULL_UP)>
    , <&pro_micro 5 (GPIO_ACTIVE_LOW | GPIO_PULL_UP)>
    , <&pro_micro 4 (GPIO_ACTIVE_LOW | GPIO_PULL_UP)>
    , <&pro_micro 8 (GPIO_ACTIVE_LOW | GPIO_PULL_UP)>
    , <&pro_micro 9 (GPIO_ACTIVE_LOW | GPIO_PULL_UP)>
    ;
};