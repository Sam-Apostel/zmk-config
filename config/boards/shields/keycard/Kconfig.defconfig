## config/boards/shields/keycard/Kconfig.defconfig
```kconfig
if SHIELD_KEYCARD_LEFT

config ZMK_KEYBOARD_NAME
    default "Keycard"

config ZMK_SPLIT_ROLE_CENTRAL
    default y

endif


if SHIELD_KEYCARD_LEFT || SHIELD_KEYCARD_RIGHT
    config ZMK_SPLIT
        default y

endif
```

## config/boards/shields/keycard/Kconfig.shield
```kconfig
config SHIELD_KEYCARD_LEFT
	def_bool $(shields_list_contains,keycard_left)

config SHIELD_KEYCARD_RIGHT
	def_bool $(shields_list_contains,keycard_right)
```
